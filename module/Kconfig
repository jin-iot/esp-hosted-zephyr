## module/Kconfig
```kconfig
source "$(ZEPHYR_ESP_HOSTED_MODULE_DIR)/drivers/mfd/Kconfig"
source "$(ZEPHYR_ESP_HOSTED_MODULE_DIR)/drivers/bluetooth/Kconfig"
source "$(ZEPHYR_ESP_HOSTED_MODULE_DIR)/drivers/wifi/Kconfig"
```

## module/drivers/bluetooth/Kconfig
```kconfig
if BT_HCI
source "$(ZEPHYR_ESP_HOSTED_MODULE_DIR)/drivers/bluetooth/hci/Kconfig"
endif
```

## module/drivers/bluetooth/hci/Kconfig
```kconfig
config BT_ESP_HOSTED
    bool "Espressif esp-hosted Bluetooth HCI support"
    default y
    depends on DT_HAS_ESPRESSIF_HCI_ESP_HOSTED_ENABLED
    help
        Enable Bluetooth support for Espressif esp-hosted devices.
        More information about the esp-hosted project could be found at
        https://github.com/espressif/esp-hosted
```

## module/drivers/mfd/Kconfig.esp-hosted
```kconfig
# esp-hosted WiFi driver options

config MFD_ESP_HOSTED
    bool "Espressif esp-hosted device support"
    default y
    depends on DT_HAS_ESPRESSIF_ESP_HOSTED_ENABLED
    select MFD

if MFD_ESP_HOSTED

config MFD_ESP_HOSTED_BUS_BUF_SIZE
    int "esp-hosted buffers for transceive size"
    default 1600

config MFD_ESP_HOSTED_SPI
    bool "esp-hosted SPI interface"
    default y
    select SPI

config MFD_ESP_HOSTED_SDHC
    bool "esp-hosted SDHC interface"
    default n
    select SDHC

endif # MFD_ESP_HOSTED
```

## module/drivers/wifi/Kconfig
```kconfig
source "$(ZEPHYR_ESP_HOSTED_MODULE_DIR)/drivers/wifi/esp_hosted/Kconfig.esp-hosted-wifi"
```

## module/drivers/wifi/esp-hosted/Kconfig.esp-hosted
```kconfig
# esp-hosted WiFi driver options

menuconfig WIFI_ESP_HOSTED
    bool "Espressif esp-hosted device support"
    default y
    depends on DT_HAS_ESPRESSIF_ESP_HOSTED_ENABLED
    select WIFI
    select WIFI_OFFLOAD
    select NET_L2_WIFI_MGMT

if WIFI_ESP_HOSTED

config WIFI_ESP_HOSTED_SPI
    bool "esp-hosted SPI interface"
    default y
    select SPI

config WIFI_ESP_HOSTED_SDIO
    bool "esp-hosted SDIO interface"
    default n
    select SDIO

endif # WIFI_ESP_HOSTED
```

## module/drivers/wifi/esp_hosted/Kconfig.esp-hosted-wifi
```kconfig
config WIFI_ESP_HOSTED
    bool "ESP Hosted WiFi"
    depends on MFD_ESP_HOSTED && DT_HAS_ESPRESSIF_WIFI_ESP_HOSTED_ENABLED
    select WIFI
    select WIFI_OFFLOAD
    select WIFI_USE_NATIVE_NETWORKING
    select NET_L2_WIFI_MGMT
    help
      Enable ESP Hosted WiFi driver.

if WIFI_ESP_HOSTED



endif # WIFI_ESP_HOSTED
```

## module/dts/bindings/bluetooth/espressif,hci-esp-hosted.yaml
```yaml
description: ESP-Hosted WIFI Module

compatible: "espressif,hci-esp-hosted"
on-bus: esp-hosted
```

## module/dts/bindings/mfd/espressif,esp-hosted-sdhc.yaml
```yaml
# description: ESP-Hosted Module over SPI

# compatible: "espressif,esp-hosted"
# on-bus: sdhc

# include: sdhc.yaml

# properties:
#   reset-gpios:
#     type: phandle-array
#     required: true

# bus: esp-hosted
```

## module/dts/bindings/mfd/espressif,esp-hosted-spi.yaml
```yaml
description: ESP-Hosted Module over SPI

compatible: "espressif,esp-hosted"
on-bus: spi

include: spi-device.yaml

properties:
  reset-gpios:
    type: phandle-array
    required: true
  
  data-ready-gpios:
    type: phandle-array
    required: true

  handshake-gpios:
    type: phandle-array

bus: esp-hosted
```

## module/dts/bindings/wifi/espressif,esp-hosted-wifi.yaml
```yaml
description: ESP-Hosted WIFI Module

compatible: "espressif,esp-hosted-wifi"
on-bus: esp-hosted
```

## module/dts/bindings/wifi/espressif,esp-hosted.yaml
```yaml
description: esp-hosted WiFi module

compatible: "espressif,esp-hosted"

properties:
  reset-gpios:
    type: phandle-array
    required: true

  data-ready-gpios:
    type: phandle-array
    required: true

  handshake-gpios:
    type: phandle-array

include: spi-device.yaml
```
